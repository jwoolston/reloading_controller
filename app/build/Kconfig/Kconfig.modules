## app/build/Kconfig/Kconfig.modules
```kconfig
menu "controller (C:/zephyr_development/reloading_controller/controller)"
osource "C:/zephyr_development/reloading_controller/controller/Kconfig"
config ZEPHYR_CONTROLLER_MODULE
	bool
	default y
endmenu
menu "cmsis (C:/zephyr_development/reloading_controller/modules/hal/cmsis)"
osource "$(ZEPHYR_CMSIS_KCONFIG)"
config ZEPHYR_CMSIS_MODULE
	bool
	default y
endmenu
menu "hal_rpi_pico (C:/zephyr_development/reloading_controller/modules/hal/rpi_pico)"
osource "$(ZEPHYR_HAL_RPI_PICO_KCONFIG)"
config ZEPHYR_HAL_RPI_PICO_MODULE
	bool
	default y
endmenu
menu "lvgl (C:/zephyr_development/reloading_controller/modules/lib/gui/lvgl)"
osource "C:/zephyr_development/reloading_controller/modules/lib/gui/lvgl/zephyr/Kconfig"
config ZEPHYR_LVGL_MODULE
	bool
	default y
endmenu
```

## app/build/Kconfig/Kconfig.shield.defconfig
```kconfig
osource "C:/zephyr_development/reloading_controller/controller/boards/shields/*/Kconfig.defconfig"
```

## app/build/Kconfig/Kconfig.sysbuild.modules
```kconfig
config ZEPHYR_CONTROLLER_MODULE
   bool
   default y
config ZEPHYR_CMSIS_MODULE
   bool
   default y
config ZEPHYR_HAL_RPI_PICO_MODULE
   bool
   default y
config ZEPHYR_LVGL_MODULE
   bool
   default y
```

## app/build/Kconfig/arch/Kconfig
```kconfig
# Load Zephyr Arch Kconfig descriptions.
osource "C:/zephyr_development/reloading_controller/zephyr/arch/x86/Kconfig"
osource "C:/zephyr_development/reloading_controller/zephyr/arch/xtensa/Kconfig"
osource "C:/zephyr_development/reloading_controller/zephyr/arch/sparc/Kconfig"
osource "C:/zephyr_development/reloading_controller/zephyr/arch/riscv/Kconfig"
osource "C:/zephyr_development/reloading_controller/zephyr/arch/posix/Kconfig"
osource "C:/zephyr_development/reloading_controller/zephyr/arch/nios2/Kconfig"
osource "C:/zephyr_development/reloading_controller/zephyr/arch/mips/Kconfig"
osource "C:/zephyr_development/reloading_controller/zephyr/arch/arm64/Kconfig"
osource "C:/zephyr_development/reloading_controller/zephyr/arch/arm/Kconfig"
osource "C:/zephyr_development/reloading_controller/zephyr/arch/arc/Kconfig"
```

## app/build/Kconfig/boards/Kconfig.defconfig
```kconfig
# Load Zephyr board defconfig descriptions.
osource "C:/zephyr_development/reloading_controller/controller/boards/waveshare/rp2350_lcd/Kconfig.defconfig"
```

## app/build/Kconfig/boards/Kconfig.qemu_cortex_m3
```kconfig
# Load board Kconfig descriptions.
osource "C:/zephyr_development/reloading_controller/zephyr/boards/qemu/cortex_m3/Kconfig.qemu_cortex_m3"
```

## app/build/Kconfig/boards/Kconfig.rp2350_lcd
```kconfig
# Load board Kconfig descriptions.
osource "C:/zephyr_development/reloading_controller/controller/boards/waveshare/rp2350_lcd/Kconfig.rp2350_lcd"
```

## app/build/Kconfig/boards/Kconfig.rpi_pico2
```kconfig
# Load board Kconfig descriptions.
osource "C:/zephyr_development/reloading_controller/zephyr/boards/raspberrypi/rpi_pico2/Kconfig.rpi_pico2"
```

## app/build/Kconfig/soc/Kconfig
```kconfig
# Load Zephyr SoC Kconfig descriptions.
osource "C:/zephyr_development/reloading_controller/zephyr/soc/xlnx/zynqmp/Kconfig"
osource "C:/zephyr_development/reloading_controller/zephyr/soc/xlnx/zynq7000/Kconfig"
osource "C:/zephyr_development/reloading_controller/zephyr/soc/xen/Kconfig"
osource "C:/zephyr_development/reloading_controller/zephyr/soc/wch/ch32v/Kconfig"
osource "C:/zephyr_development/reloading_controller/zephyr/soc/ti/simplelink/Kconfig"
osource "C:/zephyr_development/reloading_controller/zephyr/soc/ti/lm3s6965/Kconfig"
osource "C:/zephyr_development/reloading_controller/zephyr/soc/ti/k3/Kconfig"
osource "C:/zephyr_development/reloading_controller/zephyr/soc/telink/tlsr/Kconfig"
osource "C:/zephyr_development/reloading_controller/zephyr/soc/starfive/jh71xx/Kconfig"
osource "C:/zephyr_development/reloading_controller/zephyr/soc/st/stm32/Kconfig"
osource "C:/zephyr_development/reloading_controller/zephyr/soc/snps/qemu_arc/Kconfig"
osource "C:/zephyr_development/reloading_controller/zephyr/soc/snps/nsim/arc_v/Kconfig"
osource "C:/zephyr_development/reloading_controller/zephyr/soc/snps/nsim/arc_classic/Kconfig"
osource "C:/zephyr_development/reloading_controller/zephyr/soc/snps/hsdk4xd/Kconfig"
osource "C:/zephyr_development/reloading_controller/zephyr/soc/snps/hsdk/Kconfig"
osource "C:/zephyr_development/reloading_controller/zephyr/soc/snps/emsk/Kconfig"
osource "C:/zephyr_development/reloading_controller/zephyr/soc/snps/emsdp/Kconfig"
osource "C:/zephyr_development/reloading_controller/zephyr/soc/snps/arc_iot/Kconfig"
osource "C:/zephyr_development/reloading_controller/zephyr/soc/silabs/Kconfig"
osource "C:/zephyr_development/reloading_controller/zephyr/soc/sifive/sifive_freedom/Kconfig"
osource "C:/zephyr_development/reloading_controller/zephyr/soc/sensry/Kconfig"
osource "C:/zephyr_development/reloading_controller/zephyr/soc/rockchip/Kconfig"
osource "C:/zephyr_development/reloading_controller/zephyr/soc/renode/riscv_virtual/Kconfig"
osource "C:/zephyr_development/reloading_controller/zephyr/soc/renode/cortex_r8_virtual/Kconfig"
osource "C:/zephyr_development/reloading_controller/zephyr/soc/renesas/smartbond/Kconfig"
osource "C:/zephyr_development/reloading_controller/zephyr/soc/renesas/rzt2m/Kconfig"
osource "C:/zephyr_development/reloading_controller/zephyr/soc/renesas/rz/Kconfig"
osource "C:/zephyr_development/reloading_controller/zephyr/soc/renesas/rcar/Kconfig"
osource "C:/zephyr_development/reloading_controller/zephyr/soc/renesas/ra/Kconfig"
osource "C:/zephyr_development/reloading_controller/zephyr/soc/realtek/ec/Kconfig"
osource "C:/zephyr_development/reloading_controller/zephyr/soc/raspberrypi/rpi_pico/Kconfig"
osource "C:/zephyr_development/reloading_controller/zephyr/soc/quicklogic/eos_s3/Kconfig"
osource "C:/zephyr_development/reloading_controller/zephyr/soc/qemu/virt_riscv/Kconfig"
osource "C:/zephyr_development/reloading_controller/zephyr/soc/qemu/malta/Kconfig"
osource "C:/zephyr_development/reloading_controller/zephyr/soc/openisa/rv32m1/Kconfig"
osource "C:/zephyr_development/reloading_controller/zephyr/soc/nxp/s32/Kconfig"
osource "C:/zephyr_development/reloading_controller/zephyr/soc/nxp/rw/Kconfig"
osource "C:/zephyr_development/reloading_controller/zephyr/soc/nxp/mcx/Kconfig"
osource "C:/zephyr_development/reloading_controller/zephyr/soc/nxp/lpc/Kconfig"
osource "C:/zephyr_development/reloading_controller/zephyr/soc/nxp/layerscape/Kconfig"
osource "C:/zephyr_development/reloading_controller/zephyr/soc/nxp/kinetis/Kconfig"
osource "C:/zephyr_development/reloading_controller/zephyr/soc/nxp/imxrt/Kconfig"
osource "C:/zephyr_development/reloading_controller/zephyr/soc/nxp/imx/Kconfig"
osource "C:/zephyr_development/reloading_controller/zephyr/soc/nuvoton/numicro/Kconfig"
osource "C:/zephyr_development/reloading_controller/zephyr/soc/nuvoton/numaker/Kconfig"
osource "C:/zephyr_development/reloading_controller/zephyr/soc/nuvoton/npcx/Kconfig"
osource "C:/zephyr_development/reloading_controller/zephyr/soc/nuvoton/npcm/Kconfig"
osource "C:/zephyr_development/reloading_controller/zephyr/soc/nordic/Kconfig"
osource "C:/zephyr_development/reloading_controller/zephyr/soc/neorv32/Kconfig"
osource "C:/zephyr_development/reloading_controller/zephyr/soc/native/inf_clock/Kconfig"
osource "C:/zephyr_development/reloading_controller/zephyr/soc/microchip/miv/Kconfig"
osource "C:/zephyr_development/reloading_controller/zephyr/soc/microchip/mec/Kconfig"
osource "C:/zephyr_development/reloading_controller/zephyr/soc/mediatek/mt8xxx/Kconfig"
osource "C:/zephyr_development/reloading_controller/zephyr/soc/lowrisc/opentitan/Kconfig"
osource "C:/zephyr_development/reloading_controller/zephyr/soc/litex/litex_vexriscv/Kconfig"
osource "C:/zephyr_development/reloading_controller/zephyr/soc/ite/ec/Kconfig"
osource "C:/zephyr_development/reloading_controller/zephyr/soc/intel/raptor_lake/Kconfig"
osource "C:/zephyr_development/reloading_controller/zephyr/soc/intel/lakemont/Kconfig"
osource "C:/zephyr_development/reloading_controller/zephyr/soc/intel/intel_socfpga_std/Kconfig"
osource "C:/zephyr_development/reloading_controller/zephyr/soc/intel/intel_socfpga/Kconfig"
osource "C:/zephyr_development/reloading_controller/zephyr/soc/intel/intel_niosv/Kconfig"
osource "C:/zephyr_development/reloading_controller/zephyr/soc/intel/intel_ish/Kconfig"
osource "C:/zephyr_development/reloading_controller/zephyr/soc/intel/intel_adsp/Kconfig"
osource "C:/zephyr_development/reloading_controller/zephyr/soc/intel/elkhart_lake/Kconfig"
osource "C:/zephyr_development/reloading_controller/zephyr/soc/intel/atom/Kconfig"
osource "C:/zephyr_development/reloading_controller/zephyr/soc/intel/apollo_lake/Kconfig"
osource "C:/zephyr_development/reloading_controller/zephyr/soc/intel/alder_lake/Kconfig"
osource "C:/zephyr_development/reloading_controller/zephyr/soc/infineon/cat3/Kconfig"
osource "C:/zephyr_development/reloading_controller/zephyr/soc/infineon/cat1b/Kconfig"
osource "C:/zephyr_development/reloading_controller/zephyr/soc/infineon/cat1a/Kconfig"
osource "C:/zephyr_development/reloading_controller/zephyr/soc/gd/gd32/Kconfig"
osource "C:/zephyr_development/reloading_controller/zephyr/soc/gaisler/leon3/Kconfig"
osource "C:/zephyr_development/reloading_controller/zephyr/soc/gaisler/gr716a/Kconfig"
osource "C:/zephyr_development/reloading_controller/zephyr/soc/espressif/Kconfig"
osource "C:/zephyr_development/reloading_controller/zephyr/soc/ene/kb1200/Kconfig"
osource "C:/zephyr_development/reloading_controller/zephyr/soc/efinix/sapphire/Kconfig"
osource "C:/zephyr_development/reloading_controller/zephyr/soc/cdns/xtensa_sample_controller/Kconfig"
osource "C:/zephyr_development/reloading_controller/zephyr/soc/cdns/sample_controller32/Kconfig"
osource "C:/zephyr_development/reloading_controller/zephyr/soc/cdns/dc233c/Kconfig"
osource "C:/zephyr_development/reloading_controller/zephyr/soc/brcm/bcmvk/Kconfig"
osource "C:/zephyr_development/reloading_controller/zephyr/soc/brcm/bcm2712/Kconfig"
osource "C:/zephyr_development/reloading_controller/zephyr/soc/brcm/bcm2711/Kconfig"
osource "C:/zephyr_development/reloading_controller/zephyr/soc/atmel/sam0/Kconfig"
osource "C:/zephyr_development/reloading_controller/zephyr/soc/atmel/sam/Kconfig"
osource "C:/zephyr_development/reloading_controller/zephyr/soc/aspeed/Kconfig"
osource "C:/zephyr_development/reloading_controller/zephyr/soc/arm/Kconfig"
osource "C:/zephyr_development/reloading_controller/zephyr/soc/arm/beetle/Kconfig"
osource "C:/zephyr_development/reloading_controller/zephyr/soc/antmicro/myra/Kconfig"
osource "C:/zephyr_development/reloading_controller/zephyr/soc/andestech/Kconfig"
osource "C:/zephyr_development/reloading_controller/zephyr/soc/amd/acp_6_0/Kconfig"
osource "C:/zephyr_development/reloading_controller/zephyr/soc/ambiq/Kconfig"
osource "C:/zephyr_development/reloading_controller/zephyr/soc/altr/zephyr_nios2f/Kconfig"
osource "C:/zephyr_development/reloading_controller/zephyr/soc/altr/qemu_nios2/Kconfig"
osource "C:/zephyr_development/reloading_controller/zephyr/soc/adi/max32/Kconfig"
```

## boards/waveshare/rp2350_lcd/Kconfig
```kconfig
# Copyright (c) 2025 Jared Woolston
# SPDX-License-Identifier: Apache-2.0

config BOARD_RP2350_LCD
	select RP2_FLASH_P25Q32SH
```

## boards/waveshare/rp2350_lcd/Kconfig.defconfig
```kconfig
# Copyright (c) 2025 Jared Woolston
# SPDX-License-Identifier: Apache-2.0

if BOARD_RP2350_LCD

config USB_SELF_POWERED
	default n

if I2C_DW

config I2C_DW_CLOCK_SPEED
	default 125

endif # I2C_DW

endif # BOARD_RP2350_LCD
```

## boards/waveshare/rp2350_lcd/Kconfig.rp2350_lcd
```kconfig
# Copyright (c) 2025 Jared Woolston
# SPDX-License-Identifier: Apache-2.0

config BOARD_RP2350_LCD
	select SOC_RP2350A_M33 if BOARD_RP2350_LCD_RP2350A_M33
```

## boards/waveshare/rp2350_lcd/board.yml
```yaml
# Copyright (c) 2025 Jared Woolston
# SPDX-License-Identifier: Apache-2.0

board:
  name: rp2350_lcd
  full_name: RP2350 LCD 1.28in
  vendor: waveshare
  socs:
    - name: rp2350a
```

## boards/waveshare/rp2350_lcd_touch/Kconfig
```kconfig
# Copyright (c) 2025 Jared Woolston
# SPDX-License-Identifier: Apache-2.0

config BOARD_RP2350_LCD_TOUCH
	select RP2_FLASH_W25Q128JV
```

## boards/waveshare/rp2350_lcd_touch/Kconfig.rp2350_lcd_touch
```kconfig
# Copyright (c) 2025 Jared Woolston
# SPDX-License-Identifier: Apache-2.0

config BOARD_RP2350_LCD_TOUCH
	select SOC_RP2350A_M33 if BOARD_RP2350_LCD_TOUCH_RP2350A_M33
```

## boards/waveshare/rp2350_lcd_touch/board.yml
```yaml
# Copyright (c) 2025 Jared Woolston
# SPDX-License-Identifier: Apache-2.0

board:
  name: rp2350_lcd_touch
  full_name: RP2350 LCD 1.28in Touch Screen
  vendor: waveshare
  socs:
    - name: rp2350a
```

## drivers/Kconfig
```kconfig
# Copyright (c) 2025 Jared Woolston
# SPDX-License-Identifier: Apache-2.0

menu "Drivers"
rsource "input/Kconfig"
rsource "motor/Kconfig"
rsource "sensor/Kconfig"
endmenu
```

## drivers/input/Kconfig
```kconfig
# Copyright (c) 2025 Jared Woolston
# SPDX-License-Identifier: Apache-2.0

if INPUT
rsource "Kconfig.rpi_pico"
endif # INPUT
```

## drivers/input/Kconfig.rpi_pico
```kconfig
# Copyright (c) 2025 Jared Woolston
# SPDX-License-Identifier: Apache-2.0

config INPUT_RPI_PICO_PIO_QDEC
	bool "Raspberry Pi PIO Quadrature Encoder Input driver"
	default y
	depends on DT_HAS_RASPBERRYPI_PICO_QDEC_PIO_ENABLED
	depends on DT_HAS_RASPBERRYPI_PICO_DMA_ENABLED
	select PICOSDK_USE_PIO
	select PICOSDK_USE_CLAIM
	select PINCTRL
	depends on RESET
```

## drivers/motor/Kconfig.l298n
```kconfig
# Copyright (c) 2025 Jared Woolston
# SPDX-License-Identifier: Apache-2.0

if MOTOR
config MOTOR_L298N
	bool "L298N Dual H-Bridge Motor Driver"
	default n
	select PINCTRL
	depends on PWM
	depends on GPIO
endif #MOTOR
```

## drivers/sensor/Kconfig
```kconfig
# Copyright (c) 2025 Jared Woolston
# SPDX-License-Identifier: Apache-2.0

if SENSOR
rsource "example_sensor/Kconfig"
rsource "qmi8658c/Kconfig"
endif # SENSOR
```

## drivers/sensor/example_sensor/Kconfig
```kconfig
# Copyright (c) 2025 Jared Woolston
# SPDX-License-Identifier: Apache-2.0

config EXAMPLE_SENSOR
	bool "Example sensor"
	default y
	depends on DT_HAS_ZEPHYR_EXAMPLE_SENSOR_ENABLED
	select GPIO
	help
	  Enable example sensor
```

## drivers/sensor/qdec_pico_pio/Kconfig
```kconfig
# Copyright (c) 2025 Jared Woolston
# SPDX-License-Identifier: Apache-2.0
#

config QDEC_PICO_PIO
	bool "RP2040/RP2350 PICO QDEC driver"
	default y
	depends on DT_HAS_RASPBERRYPI_PICO_QDEC_ENABLED
	select PINCTRL
	select DMA
	help
	  STM32 family Quadrature Decoder driver.
```
