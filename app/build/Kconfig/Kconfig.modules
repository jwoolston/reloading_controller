## drivers/sensor/qmi8658c/Kconfig
```kconfig
# QST QMI8658C 6-axis IMU sensor driver

# Copyright (c) 2025 Jared Woolston
# SPDX-License-Identifier: Apache-2.0

menuconfig QMI8658C
	bool "QMI8658C I2C/I3C/SPI accelerometer and gyroscope Chip"
	default y
	depends on DT_HAS_QMI8658C_ENABLED
	select I2C if $(dt_compat_on_bus,$(DT_COMPAT_QMI8658C),i2c) || \
		      $(dt_compat_on_bus,$(DT_COMPAT_QMI8658C),i2c)
	select SPI if $(dt_compat_on_bus,$(DT_COMPAT_QMI8658C),spi) || \
		      $(dt_compat_on_bus,$(DT_COMPAT_QMI8658C),spi)
    select I3C if $(dt_compat_on_bus,$(DT_COMPAT_QMI8658C),i3c) || \
		      $(dt_compat_on_bus,$(DT_COMPAT_QMI8658C),i3c)
	help
	  Enable driver for QMI8658C accelerometer and gyroscope
	  sensor.

if QMI8658C

choice QMI8658C_TRIGGER_MODE
	prompt "Trigger mode"
	help
	  Specify the type of triggering to be used by the driver.

config QMI8658C_TRIGGER_NONE
	bool "No trigger"

config QMI8658C_TRIGGER_GLOBAL_THREAD
	bool "Use global thread"
	depends on GPIO
	depends on $(dt_compat_any_has_prop,$(DT_COMPAT_QMI8658C),irq-gpios)
	select QMI8658C_TRIGGER

config QMI8658C_TRIGGER_OWN_THREAD
	bool "Use own thread"
	depends on GPIO
	select QMI8658C_TRIGGER

endchoice

config QMI8658C_TRIGGER
	bool

if QMI8658C_TRIGGER

config QMI8658C_THREAD_PRIORITY
	int "Thread priority"
	depends on QMI8658C_TRIGGER_OWN_THREAD
	default 10
	help
	  Priority of thread used by the driver to handle interrupts.

config QMI8658C_THREAD_STACK_SIZE
	int "Thread stack size"
	depends on QMI8658C_TRIGGER_OWN_THREAD
	default 1024
	help
	  Stack size of thread used by the driver to handle interrupts.

endif # QMI8658C_TRIGGER

config QMI8658C_ENABLE_TEMP
	bool "Temperature"
	help
	  Enable/disable temperature

endif # QMI8658C
```

## dts/bindings/gpio/waveshare,rp2350-lcd-h1.yaml
```yaml
# Copyright (c) 2025, Jared Woolston
# SPDX-License-Identifier: Apache-2.0

description: |
    GPIO pins exposed on Waveshare RP2350 LCD 1.28 headers.

    The Waveshare RP2350 LCD 1.28 layout provides 2 headers with 2 columns of 10 pins headers. This is the H1 header.

    This binding provides a nexus mapping for the default 16 pins as depicted below:
    
        0  GPIO8/LCD_DC        GPIO0/UART0_TX  1        
        2  GPIO9/LCD_CS        GPIO1/UART0_RX  3
        4  GPIO10/LCD_CLK      GPIO2           5
        6  GPIO11/LCD_MOSI     GPIO3           7
        8  GPIO12/LCD_RESET    GPIO4           9
        10 GPIO13              GPIO5           11
        12 GPIO14              GPIO6/IMU_SDA   13
        14 GPIO15              GPIO7/IMU_SCL   15
        -  SWCLK               VSYS            -
        -  SWDIO               GND             -
    

compatible: "waveshare,rp2350-lcd-h1"

include: [gpio-nexus.yaml, base.yaml]
```
