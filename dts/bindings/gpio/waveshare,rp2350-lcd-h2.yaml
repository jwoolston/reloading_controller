## dts/bindings/gpio/waveshare,rp2350-lcd-h2.yaml
```yaml
# Copyright (c) 2025, Jared Woolston
# SPDX-License-Identifier: Apache-2.0

description: |
    GPIO pins exposed on Waveshare RP2350 LCD 1.28 headers.

    The Waveshare RP2350 LCD 1.28 layout provides 2 headers with 2 columns of 10 pins headers. This is the H2 header.

    This binding provides a nexus mapping for the default 16 pins as depicted below:
    
        -  GND                 GND             -        
        -  VSYS                ADC_AVDD        -
        13 GPIO23/IMU_INT1     BOOT            -
        12 GPIO22              RUN             -
        11 GPIO21              GPIO29/BAT_ADC  10        
        9  GPIO20              GPIO28          8
        7  GPIO19              GPIO27          6
        5  GPIO18              GPIO26          4
        3  GPIO17              GPIO25/LCD_BL   2
        1  GPIO16              GPIO24/IMU_INT2 0
    

compatible: "waveshare,rp2350-lcd-h2"

include: [gpio-nexus.yaml, base.yaml]
```

## dts/bindings/gpio/waveshare,rp2350-lcd-touch-h1.yaml
```yaml
# Copyright (c) 2025, Jared Woolston
# SPDX-License-Identifier: Apache-2.0

description: |
    GPIO pins exposed on Waveshare RP2350 LCD 1.28 Touch header.

    The Waveshare RP2350 LCD 1.28 Touch layout provides 1 header with 1 row of 12 pins. This is the H1 header.

    This binding provides a nexus mapping for the default 12 pins as depicted below:
    
        -  GND         
        -  VSYS 
        -  RUN     
        -  BOOT 
        -  GND
        - ADC_AVDD            
        1 GPIO16           
        2 GPIO17           
        3  GPIO18         
        4  GPIO26          
        5  GPIO27
        6  GPIO28
    

compatible: "waveshare,rp2350-lcd-touch-h1"

include: [gpio-nexus.yaml, base.yaml]
```

## dts/bindings/input/raspberrypi,pico-qdec-pio.yaml
```yaml
# Copyright 2025 Jared Woolston
# SPDX-License-Identifier: Apache-2.0

description: |
  Raspberry Pi Pico PIO Quadrature Encoder Input Device

  Implement an input device generating relative axis event reports for a rotary
  encoder connected to two GPIOs via a PIO. This driver requires use of a DMA
  channel and will not be enabled if the DMA is not enabled.

  Example configuration:

  #include <zephyr/dt-bindings/input/input-event-codes.h>

  qdec {
    status = "okay";
    compatible = "raspberrypi,pico-qdec-pio";
    pinctrl-0 = <&pio1_qdec_default>;
    pinctrl-names = "default";
    btn-gpios = <&gpio0 15 (GPIO_ACTIVE_LOW | GPIO_PULL_UP)>;
    zephyr,axis = <INPUT_REL_WHEEL>;
    zephyr,key = <INPUT_KEY_0>;
    dmas = <&dma 0 RPI_PICO_DMA_SLOT_PIO1_RX0 0>;
    dma-names = "qdec";
  };
  
  &pinctrl {
    pio1_qdec_default: pio1_qdec_default {
      clk_pin {
        pinmux = <PIO1_P13>;
        input-enable;
        bias-pull-down;
      };
      dt_pin {
        pinmux = <PIO1_P14>;
        input-enable;
        bias-pull-down;
      };
    };
  };
  
  &dma {
    status = "okay";
  };

compatible: "raspberrypi,pico-qdec-pio"

include: [base.yaml, "raspberrypi,pico-pio-device.yaml"]

properties:

  btn-gpios:
    type: phandle-array
    required: true
    description: |
      A single GPIO for the button press signal.

  zephyr,axis:
    type: int
    required: true
    description: |
      The input code for the axis to report for the device, typically any of
      INPUT_REL_*.

  zephyr,key:
    type: int
    required: true
    description: |
      The input code for the key to report for the device, typically any of
      INPUT_KEY_*.

  max-update-freq:
    type: int
    required: false
    description: |
      Specifies the maximum encoder update frequency. This can be used to 
      lower the clock of the state machine to save power if the application 
      doesn't require a very high sampling rate. Passing zero or omitting
      will set the clock to the maximum (12.5 Msps).
```

## dts/bindings/motor/motor-l298n.yaml
```yaml
# Copyright (c) 2025 Jared Woolston
# SPDX-License-Identifier: Apache-2.0

description: |
  PWM-driven Dual H Bridge. 
  
  Example configuration:
  
  motors: motors {
    compatible = "motor-l298n";
    pwms = <&pwm 0 PWM_MSEC(20) PWM_POLARITY_NORMAL>, // PWM_0A_P16
           <&pwm 1 PWM_MSEC(20) PWM_POLARITY_NORMAL>; // PWM_0B_P17
    ch-1-dir-gpios = <&gpio0 18 (GPIO_ACTIVE_LOW | GPIO_PULL_UP)>;
    ch-2-dir-gpios = <&gpio0 26 (GPIO_ACTIVE_LOW | GPIO_PULL_UP)>;
  };

compatible: "motor-l298n"

include: base.yaml

properties:
  pwms:
    required: true
    type: phandle-array
    description: PWM specifier driving the enable inputs. Expects 1 or 2 
      entries for 1/2 channels.

  ch-1-dir-gpios:
    type: phandle-array
    required: false
    description: |
      Array of direction control GPIOs for CH1. It is assumed that the first 
      GPIO corresponds to the lower numbered input on the L298N and thus a 
      logic H represents the "forward" direction. If only 1 GPIO is provided, 
      braking functionality will be disabled. If no GPIO is provided, direction
      control will be disabled.

  ch-2-dir-gpios:
    type: phandle-array
    required: false
    description: |
      Array of direction control GPIOs for CH2. It is assumed that the first 
      GPIO corresponds to the lower numbered input on the L298N and thus a 
      logic H represents the "forward" direction. If only 1 GPIO is provided, 
      braking functionality will be disabled. If no GPIO is provided, direction
      control will be disabled.
```

## dts/bindings/sensor/qst,qmi8658c-common.yaml
```yaml
# Copyright (c) 2025 Jared Woolston
# SPDX-License-Identifier: Apache-2.0

description: |
    When setting the accel-pm, accel-range, accel-odr, gyro-pm, gyro-range,
    gyro-odr properties in a .dts or .dtsi file you may include qmi8658c.h
    and use the macros defined there.

    Example:
    #include <zephyr/dt-bindings/sensor/qmi8658c.h>
  
    qmi8658c: qmi8658c@0 {
      ...

      accel-pm = <QMI8658C_DT_XL_ULP_MODE>;
      accel-range = <QMI8658C_DT_FS_8G>;
      accel-odr = <QMI8658C_DT_ODR_1Hz6>;
      gyro-pm = <QMI8658C_DT_GY_NORMAL_MODE>;
      gyro-range = <QMI8658C_DT_FS_2000DPS>;
      gyro-odr = <QMI8658C_DT_ODR_6667Hz>;
    };

include: sensor-device.yaml

properties:
  irq-gpios:
    type: phandle-array
    description: |
      DRDY pin

      This pin defaults to active high when produced by the sensor.
      The property value should ensure the flags properly describe
      the signal that is presented to the driver.

  int-pin:
    type: int
    default: 1
    enum:
      - 1 # drdy is generated from INT1
      - 2 # drdy is generated from INT2
    description: |
      Select DRDY pin number (1 or 2).

      This number represents which of the two interrupt pins
      (INT1 or INT2) the drdy line is attached to. This property is not
      mandatory and if not present it defaults to 1 which is the
      configuration at power-up.

  accel-pm:
    type: int
    default: 0
    description: |
      Specify the accelerometer power mode.
      Default is power-up configuration.

      - 0 # QMI8658C_DT_XL_HP_MODE
      - 1 # QMI8658C_DT_XL_LP_NORMAL_MODE
      - 2 # QMI8658C_DT_XL_ULP_MODE

    enum: [0, 1, 2]

  accel-range:
    type: int
    default: 0
    description: |
      Range in g. Default is power-up configuration.

      - 0 # QMI8658C_DT_FS_2G  (0.061 mg/LSB) (QMI8658C32 will be double these values)
      - 1 # QMI8658C_DT_FS_16G (0.488 mg/LSB)
      - 2 # QMI8658C_DT_FS_4G  (0.122 mg/LSB)
      - 3 # QMI8658C_DT_FS_8G  (0.244 mg/LSB)

    enum: [0, 1, 2, 3]

  accel-odr:
    type: int
    default: 0
    description: |
      Specify the default accelerometer output data rate expressed in samples per second (Hz).
      Default is power-up configuration.

      - 0  # QMI8658C_DT_ODR_OFF
      - 1  # QMI8658C_DT_ODR_LOW_PWR_3Hz
      - 2  # QMI8658C_DT_ODR_LOW_PWR_11Hz
      - 3  # QMI8658C_DT_ODR_LOW_PWR_21Hz
      - 4  # QMI8658C_DT_ODR_LOW_PWR_128Hz
      - 5  # QMI8658C_DT_ODR_HI_RES_31Hz25
      - 6  # QMI8658C_DT_ODR_HI_RES_62Hz5
      - 7  # QMI8658C_DT_ODR_HI_RES_125Hz
      - 8  # QMI8658C_DT_ODR_HI_RES_250Hz
      - 9  # QMI8658C_DT_ODR_HI_RES_500Hz
      - 10 # QMI8658C_DT_ODR_HI_RES_1000Hz
      - 11 # QMI8658C_DT_ODR_HI_RES_1793Hz6
      - 12 # QMI8658C_DT_ODR_HI_RES_3587Hz2
      - 13 # QMI8658C_DT_ODR_HI_RES_7174Hz4

    enum: [0, 1, 2, 3, 4, 5, 6, 7, 8, 9, 10, 11, 12, 13]

  gyro-pm:
    type: int
    default: 0
    description: |
      Specify the gyrometer power mode.
      Default is power-up configuration.

      - 0 # QMI8658C_DT_GY_LOW_PWR_MODE
      - 1 # QMI8658C_DT_GY_HI_RES_MODE

    enum: [0, 1]

  gyro-range:
    type: int
    default: 0
    description: |
      Range in dps. Default is power-up configuration.

      - 0 # QMI8658C_DT_FS_250DPS  (8.75 mdps/LSB)
      - 1 # QMI8658C_DT_FS_125DPS  (4.375 mdps/LSB)
      - 2 # QMI8658C_DT_FS_500DPS  (17.50 mdps/LSB)
      - 4 # QMI8658C_DT_FS_1000DPS (35 mdps/LSB)
      - 6 # QMI8658C_DT_FS_2000DPS (70 mdps/LSB)

    enum: [0, 1, 2, 4, 6]

  gyro-odr:
    type: int
    default: 0
    description: |
      Specify the default gyro output data rate expressed in samples per second (Hz).
      Default is power-up configuration.

      - 0  # QMI8658C_DT_ODR_OFF
      - 1  # QMI8658C_DT_ODR_LOW_PWR_3Hz
      - 2  # QMI8658C_DT_ODR_LOW_PWR_11Hz
      - 3  # QMI8658C_DT_ODR_LOW_PWR_21Hz
      - 4  # QMI8658C_DT_ODR_LOW_PWR_128Hz
      - 5  # QMI8658C_DT_ODR_HI_RES_28Hz025
      - 6  # QMI8658C_DT_ODR_HI_RES_56Hz05
      - 7  # QMI8658C_DT_ODR_HI_RES_112Hz1
      - 8  # QMI8658C_DT_ODR_HI_RES_224Hz2
      - 9  # QMI8658C_DT_ODR_HI_RES_448Hz4
      - 10 # QMI8658C_DT_ODR_HI_RES_896Hz8
      - 11 # QMI8658C_DT_ODR_HI_RES_1793Hz6
      - 12 # QMI8658C_DT_ODR_HI_RES_3587Hz2
      - 13 # QMI8658C_DT_ODR_HI_RES_7174Hz4
      

    enum: [0, 1, 2, 3, 4, 5, 6, 7, 8, 9, 10, 11, 12, 13]

  drdy-pulsed:
    type: boolean
    description: |
      Selects the pulsed mode for data-ready interrupt when enabled,
      and the latched mode when disabled.
```
